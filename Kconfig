## Kconfig
```kconfig
# edgefast_bluetooth configuration options

# edgefast_bluetooth protocol abstraction layer(PAL).
menuconfig MCUX_COMPONENT_middleware.edgefast_bluetooth.pal
    bool "edgefast_bluetooth"
    imply MCUX_COMPONENT_middleware.freertos-kernel
    imply MCUX_PRJSEG_config.arm.suppress.warn_as_error
    select MCUX_COMPONENT_middleware.edgefast_bluetooth.common.ethermind
    select MCUX_COMPONENT_middleware.usb.host.stack
    select MCUX_COMPONENT_middleware.usb.common_header
    select MCUX_COMPONENT_middleware.usb.host.common_header
    select MCUX_COMPONENT_middleware.edgefast_bluetooth.porting
    select MCUX_COMPONENT_middleware.edgefast_bluetooth.pal.platform.ethermind
    select MCUX_COMPONENT_middleware.edgefast_bluetooth.pal.crypto.ethermind
    select MCUX_COMPONENT_middleware.edgefast_bluetooth.pal.host_msd_fatfs.ethermind
    select MCUX_COMPONENT_middleware.edgefast_bluetooth.pal.db_gen.ethermind
    select MCUX_COMPONENT_middleware.mbedtls3x
    select MCUX_COMPONENT_middleware.edgefast_bluetooth.crypto.psa if MCUX_HW_DEVICE_MIMXRT1042 || MCUX_HW_DEVICE_MIMXRT1062 || \
                                               MCUX_HW_DEVICE_MIMXRT685S || MCUX_HW_DEVICE_MIMXRT1176 || \
                                               MCUX_HW_DEVICE_MIMXRT595S || MCUX_HW_DEVICE_MIMXRT1052 || \
                                               MCUX_HW_DEVICE_MIMXRT1189 || MCUX_HW_DEVICE_MIMXRT1187 || \
                                               MCUX_HW_DEVICE_MIMXRT1166 || MCUX_HW_DEVICE_MCXN547 || \
                                               MCUX_HW_DEVICE_MCXN947    || MCUX_HW_DEVICE_RW612
	select MCUX_COMPONENT_middleware.edgefast_bluetooth.crypto.no_psa if MCUX_HW_DEVICE_MIMXRT798S

if MCUX_COMPONENT_middleware.edgefast_bluetooth.pal

config MCUX_COMPONENT_middleware.edgefast_bluetooth.common.ethermind
    bool
    select MCUX_COMPONENT_middleware.edgefast_bluetooth.extension.common.ethermind
    select MCUX_COMPONENT_middleware.edgefast_bluetooth.config.ethermind
    select MCUX_PRJSEG_middleware.edgefast_bluetooth.common.ethermind.hci
    imply MCUX_COMPONENT_middleware.littlefs
    imply MCUX_COMPONENT_middleware.fatfs
    imply MCUX_COMPONENT_component.osa
    imply FSL_OSA_TASK_ENABLE
    help
      This option enables edgefast_bluetooth middleware component.

# ethermind extension files and config files that are always required by edgefast_bluetooth.
config MCUX_COMPONENT_middleware.edgefast_bluetooth.extension.common.ethermind
    bool

config MCUX_COMPONENT_middleware.edgefast_bluetooth.config.ethermind
    bool


# Bluetooth mode selection.
choice MCUX_COMPONENT_middleware.edgefast_bluetooth.mode_selection
    prompt "Bluetooth mode selection"
    default MCUX_COMPONENT_middleware.edgefast_bluetooth.ble.ethermind
    help
      Select the Bluetooth stack to compile.

config MCUX_COMPONENT_middleware.edgefast_bluetooth.btble.ethermind
    bool "BT/BLE"
    select MCUX_COMPONENT_middleware.edgefast_bluetooth.template
    select MCUX_COMPONENT_middleware.edgefast_bluetooth.btble.ethermind.lib
    help
      BT/BLE.

config MCUX_COMPONENT_middleware.edgefast_bluetooth.ble.ethermind
    bool "BLE"
    select MCUX_COMPONENT_middleware.edgefast_bluetooth.template
    select MCUX_COMPONENT_middleware.edgefast_bluetooth.ble.ethermind.lib
    help
      Bluetooth low energy.

config MCUX_COMPONENT_middleware.edgefast_bluetooth.br.ethermind
    bool "BR"
    depends on !MCUX_HW_DEVICE_RW612
    select MCUX_COMPONENT_middleware.edgefast_bluetooth.template
    select MCUX_COMPONENT_middleware.edgefast_bluetooth.br.ethermind.lib
    help
      Classic Bluetooth.

endchoice

rsource "Kconfig.lib"

# Template files for mbedtls and mcux linker.
config MCUX_COMPONENT_middleware.edgefast_bluetooth.template
    bool

config MCUX_COMPONENT_middleware.edgefast_bluetooth.pal.crypto.ethermind
    bool

config MCUX_COMPONENT_middleware.edgefast_bluetooth.crypto.psa
    bool
    select MCUX_COMPONENT_component.psa_crypto_driver.dcp if MCUX_HW_DEVICE_MIMXRT1052 || MCUX_HW_DEVICE_MIMXRT1062 || \
                                                             MCUX_HW_DEVICE_MIMXRT1042
    select MCUX_COMPONENT_component.psa_crypto_driver.caam if MCUX_HW_DEVICE_MIMXRT1176
    select MCUX_COMPONENT_component.psa_crypto_driver.casper if MCUX_HW_DEVICE_MIMXRT595S || MCUX_HW_DEVICE_MIMXRT685S
    select MCUX_COMPONENT_component.psa_crypto_driver.hashcrypt if MCUX_HW_DEVICE_MIMXRT595S || MCUX_HW_DEVICE_MIMXRT685S
    select MCUX_COMPONENT_component.psa_crypto_driver.ele_s4xx_psa if MCUX_HW_DEVICE_MIMXRT1189 || MCUX_HW_DEVICE_MIMXRT1187
    select MCUX_COMPONENT_component.psa_crypto_driver.els_pkc if MCUX_HW_DEVICE_MCXN947 || MCUX_HW_DEVICE_RW612 || \
                                                                 MCUX_HW_DEVICE_MCXN547

config MCUX_COMPONENT_middleware.edgefast_bluetooth.crypto.no_psa
    bool

config MCUX_COMPONENT_middleware.edgefast_bluetooth.pal.platform.ethermind
    bool

config MCUX_COMPONENT_middleware.edgefast_bluetooth.pal.host_msd_fatfs.ethermind
    bool
    select MCUX_COMPONENT_middleware.fatfs.usb
    imply MCUX_COMPONENT_middleware.edgefast_bluetooth.pal.host_msd_fatfs.ethermind.config

config MCUX_COMPONENT_middleware.edgefast_bluetooth.pal.db_gen.ethermind
    bool

config MCUX_COMPONENT_middleware.edgefast_bluetooth.pal.host_msd_fatfs.ethermind.config
    bool "FatFS config"

# Fucntioanl files required by PAL.
config MCUX_COMPONENT_middleware.edgefast_bluetooth.porting
    bool
    select MCUX_COMPONENT_middleware.edgefast_bluetooth.porting.work_queue
    select MCUX_COMPONENT_middleware.edgefast_bluetooth.porting.toolchain
    select MCUX_COMPONENT_middleware.edgefast_bluetooth.porting.net
    select MCUX_COMPONENT_middleware.edgefast_bluetooth.porting.list
    select MCUX_COMPONENT_middleware.edgefast_bluetooth.porting.atomic
    select MCUX_COMPONENT_component.log

if MCUX_COMPONENT_middleware.edgefast_bluetooth.porting

choice MCUX_COMPONENT_middleware.edgefast_bluetooth.porting_debug_console_selection
    prompt "Debug Console Mode Selection"
    default MCUX_COMPONENT_middleware.edgefast_bluetooth.porting_DEPEND_ANYOF_OPTION_1
    help
      Debug Console Selection.

config MCUX_COMPONENT_middleware.edgefast_bluetooth.porting_DEPEND_ANYOF_OPTION_1
    bool "Non-blocking mode"
    imply MCUX_COMPONENT_utility.assert
    select MCUX_PRJSEG_utility.debug_console_transfer_non_blocking

config MCUX_COMPONENT_middleware.edgefast_bluetooth.porting_DEPEND_ANYOF_OPTION_2
    bool "Blocking mode(lite)"
    imply MCUX_COMPONENT_utility.assert_lite

config MCUX_COMPONENT_middleware.edgefast_bluetooth.porting_DEPEND_ANYOF_OPTION_3
    bool "Blocking mode"
    imply MCUX_COMPONENT_utility.assert

endchoice

endif # MCUX_COMPONENT_middleware.edgefast_bluetooth.porting

config MCUX_COMPONENT_middleware.edgefast_bluetooth.porting.work_queue
    bool

config MCUX_COMPONENT_middleware.edgefast_bluetooth.porting.toolchain
    bool

config MCUX_COMPONENT_middleware.edgefast_bluetooth.porting.net
    bool

config MCUX_COMPONENT_middleware.edgefast_bluetooth.porting.list
    bool

config MCUX_COMPONENT_middleware.edgefast_bluetooth.porting.atomic
    bool

# Physical interface of HCI. Currently supports UART and RPMSG.
config MCUX_PRJSEG_middleware.edgefast_bluetooth.common.ethermind.hci
    bool

if MCUX_PRJSEG_middleware.edgefast_bluetooth.common.ethermind.hci

choice MCUX_COMPONENT_middleware.edgefast_bluetooth.common.ethermind.hci_interface_selection
    prompt "Bluetooth HCI interface Selection"
    default MCUX_COMPONENT_middleware.edgefast_bluetooth.common.ethermind.hci_platform if MCUX_HW_DEVICE_RW612
    default MCUX_COMPONENT_middleware.edgefast_bluetooth.common.ethermind.hci_uart
    help
      Select the Bluetooth HCI interface.

config MCUX_COMPONENT_middleware.edgefast_bluetooth.common.ethermind.hci_uart
    bool "UART HCI"
    depends on MCUX_HW_DEVICE_MIMXRT1042 || MCUX_HW_DEVICE_MIMXRT1062 || \
               MCUX_HW_DEVICE_MIMXRT685S || MCUX_HW_DEVICE_MIMXRT1176 || \
               MCUX_HW_DEVICE_MIMXRT595S || MCUX_HW_DEVICE_MIMXRT1052 || \
               MCUX_HW_DEVICE_MIMXRT1189 || MCUX_HW_DEVICE_MIMXRT1187 || \
               MCUX_HW_DEVICE_MIMXRT1166 || MCUX_HW_DEVICE_MCXN547 || \
               MCUX_HW_DEVICE_MCXN947    || MCUX_HW_DEVICE_MIMXRT798S
    select MCUX_COMPONENT_component.serial_manager
    select MCUX_COMPONENT_component.serial_manager_uart
    select MCUX_COMPONENT_driver.lpuart_edma if MCUX_HAS_COMPONENT_driver.lpuart_edma
    select MCUX_COMPONENT_driver.lpflexcomm_lpuart_edma if MCUX_HAS_COMPONENT_driver.lpflexcomm_lpuart_edma
    select MCUX_COMPONENT_driver.flexcomm_usart_dma if MCUX_HAS_COMPONENT_driver.flexcomm_usart_dma

config MCUX_COMPONENT_middleware.edgefast_bluetooth.common.ethermind.hci_platform
    bool "RPMSG HCI"
    depends on MCUX_HW_DEVICE_RW612
    select MCUX_COMPONENT_middleware.edgefast_bluetooth.rw610.controller

endchoice

endif # MCUX_PRJSEG_middleware.edgefast_bluetooth.common.ethermind.hci

# For UART HCI, bluetooth controller type need to be confirmed.
if MCUX_COMPONENT_middleware.edgefast_bluetooth.common.ethermind.hci_uart

config MCUX_COMPONENT_middleware.edgefast_bluetooth.wifi_nxp.controller.base
    bool
    default y if MCUX_HW_DEVICE_MIMXRT1042 || MCUX_HW_DEVICE_MIMXRT1062 || \
               MCUX_HW_DEVICE_MIMXRT685S || MCUX_HW_DEVICE_MIMXRT1176 || \
               MCUX_HW_DEVICE_MIMXRT595S || MCUX_HW_DEVICE_MIMXRT1052 || \
               MCUX_HW_DEVICE_MIMXRT1189 || MCUX_HW_DEVICE_MIMXRT1187 || \
               MCUX_HW_DEVICE_MIMXRT1166 || MCUX_HW_DEVICE_MCXN547 || \
               MCUX_HW_DEVICE_MCXN947    || MCUX_HW_DEVICE_MIMXRT798S
    select MCUX_PRJSEG_middleware.edgefast_bluetooth.sdio.template
    select MCUX_COMPONENT_middleware.wifi.fwdnld
    select MCUX_COMPONENT_middleware.wifi.osa_free_rtos

config MCUX_COMPONENT_middleware.edgefast_bluetooth.k32w061.controller
    bool
    default y if MCUX_HW_DEVICE_MIMXRT1042 || MCUX_HW_DEVICE_MIMXRT1062 || \
                 MCUX_HW_DEVICE_MIMXRT685S || MCUX_HW_DEVICE_MIMXRT1176 || \
                 MCUX_HW_DEVICE_MIMXRT595S || MCUX_HW_DEVICE_MIMXRT1052 || \
                 MCUX_HW_DEVICE_MIMXRT1189 || MCUX_HW_DEVICE_MIMXRT1187 || \
                 MCUX_HW_DEVICE_MIMXRT1166

endif # MCUX_COMPONENT_middleware.edgefast_bluetooth.common.ethermind.hci_uart


# Firmware download, especially for NXP controller.
config MCUX_PRJSEG_middleware.edgefast_bluetooth.sdio.template
    bool
    select MCUX_COMPONENT_middleware.sdmmc.host.usdhc
    select MCUX_COMPONENT_middleware.sdmmc.sdio
    select MCUX_COMPONENT_component.igpio_adapter if MCUX_HAS_COMPONENT_driver.igpio
    select MCUX_COMPONENT_component.rt_gpio_adapter if MCUX_HAS_COMPONENT_driver.lpc_gpio
    select MCUX_COMPONENT_component.rgpio_adapter if MCUX_HAS_COMPONENT_driver.rgpio
    select MCUX_COMPONENT_component.gpio_adapter if MCUX_HAS_COMPONENT_driver.gpio
    select MCUX_COMPONENT_middleware.edgefast_bluetooth.wifi_nxp.controller.lwip.config if !MCUX_COMPONENT_middleware.lwip
    select MCUX_COMPONENT_middleware.edgefast_bluetooth.wifi_nxp.controller.wifi.config if !MCUX_COMPONENT_middleware.wifi

config MCUX_COMPONENT_middleware.edgefast_bluetooth.wifi_nxp.controller.lwip.config
    bool

config MCUX_COMPONENT_middleware.edgefast_bluetooth.wifi_nxp.controller.wifi.config
    bool

# controller settings for RW610
config MCUX_COMPONENT_middleware.edgefast_bluetooth.rw610.controller
    bool

# Independent reset
config MCUX_COMPONENT_middleware.edgefast_bluetooth.controller_ind_reset
    bool "Independent reset"

# utility
rsource "Kconfig.utility"

# services components
rsource "Kconfig.services"

# audio components
rsource "Kconfig.audio"

# shell components
rsource "Kconfig.shell"

# host configuration
rsource "include/Kconfig"
rsource "include/Kconfig.debug"
rsource "include/Kconfig.extension"

endif # MCUX_COMPONENT_middleware.edgefast_bluetooth.pal
```

## Kconfig.audio
```kconfig
###############################
# LE audio related components #
###############################
menu "LE audio"

config MCUX_COMPONENT_middleware.edgefast_bluetooth.common.ethermind.lc3
	bool "LC3 extension"
    select MCUX_COMPONENT_middleware.edgefast_bluetooth.le_audio.config.template
    select MCUX_COMPONENT_middleware.edgefast_bluetooth.ble.ethermind.lib.lc3 if \
           MCUX_COMPONENT_middleware.edgefast_bluetooth.ble.ethermind
    select MCUX_COMPONENT_middleware.edgefast_bluetooth.br.ethermind.lib.lc3 if \
           MCUX_COMPONENT_middleware.edgefast_bluetooth.br.ethermind
    select MCUX_COMPONENT_middleware.edgefast_bluetooth.btble.ethermind.lib.lc3 if \
           MCUX_COMPONENT_middleware.edgefast_bluetooth.btble.ethermind
	help
	  Necessary files to support LE audio feature.

config MCUX_COMPONENT_middleware.edgefast_bluetooth.common.ethermind.lc3_nodsp
	bool "LC3 nodsp extension"
    select MCUX_COMPONENT_middleware.edgefast_bluetooth.le_audio.config.template
    select MCUX_COMPONENT_middleware.edgefast_bluetooth.ble.ethermind.lib.lc3_nodsp if \
           MCUX_COMPONENT_middleware.edgefast_bluetooth.ble.ethermind
    select MCUX_COMPONENT_middleware.edgefast_bluetooth.btble.ethermind.lib.lc3_nodsp if \
           MCUX_COMPONENT_middleware.edgefast_bluetooth.btble.ethermind
	help
	  Necessary files to support LE audio feature.

config MCUX_COMPONENT_middleware.edgefast_bluetooth.le_audio.config.template
    bool

config MCUX_COMPONENT_middleware.edgefast_bluetooth.le_audio.cap
    bool "cap"

config MCUX_COMPONENT_middleware.edgefast_bluetooth.le_audio.csip
    bool "csip"

config MCUX_COMPONENT_middleware.edgefast_bluetooth.le_audio.aics
    bool "aics"

config MCUX_COMPONENT_middleware.edgefast_bluetooth.le_audio.micp
    bool "micp"
    depends on MCUX_COMPONENT_middleware.edgefast_bluetooth.le_audio.aics

config MCUX_COMPONENT_middleware.edgefast_bluetooth.le_audio.vocs
    bool "vocs"

config MCUX_COMPONENT_middleware.edgefast_bluetooth.le_audio.vcp
    bool "vcp"
    select MCUX_COMPONENT_middleware.edgefast_bluetooth.le_audio.aics
    select MCUX_COMPONENT_middleware.edgefast_bluetooth.le_audio.vocs

config MCUX_COMPONENT_middleware.edgefast_bluetooth.le_audio.ccid
    bool "ccid"

config MCUX_COMPONENT_middleware.edgefast_bluetooth.le_audio.mcs
    bool "mcs"
    select MCUX_COMPONENT_middleware.edgefast_bluetooth.le_audio.ccid

config MCUX_COMPONENT_middleware.edgefast_bluetooth.le_audio.mcc
    bool "mcc"
    select MCUX_COMPONENT_middleware.edgefast_bluetooth.le_audio.ccid

config MCUX_COMPONENT_middleware.edgefast_bluetooth.le_audio.mpl
    bool "mpl"
    select MCUX_COMPONENT_middleware.edgefast_bluetooth.le_audio.ccid

config MCUX_COMPONENT_middleware.edgefast_bluetooth.le_audio.bass
    bool "bass"
    #depends on MCUX_COMPONENT_middleware.edgefast_bluetooth.le_audio.ccid

config MCUX_COMPONENT_middleware.edgefast_bluetooth.le_audio.bap
    bool "bap"

config MCUX_COMPONENT_middleware.edgefast_bluetooth.le_audio.has
    bool "has"

config MCUX_COMPONENT_middleware.edgefast_bluetooth.le_audio.tbs
    bool "tbs"

config MCUX_COMPONENT_middleware.edgefast_bluetooth.le_audio.tmap
    bool "tmap"

config MCUX_COMPONENT_middleware.edgefast_bluetooth.le_audio.gmap
    bool "gmap"

config MCUX_COMPONENT_middleware.edgefast_bluetooth.le_audio.pbp
    bool "pbp"

config MCUX_COMPONENT_middleware.edgefast_bluetooth.asrc_sw
    bool "asrc_sw"

# configuration
rsource "include/bluetooth/audio/config/Kconfig"

endmenu
```
