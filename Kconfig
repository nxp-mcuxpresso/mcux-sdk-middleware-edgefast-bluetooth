## include/Kconfig.extension
```kconfig
menu "Edgefast Bluetooth Extension Configurations(edgefast_bluetooth_config.h)"

config CONTROLLER_ID
    string "CONTROLLER_ID"
    default "kUSB_ControllerEhci0"
    help
      USB Controller ID
      This symbol is a config macro.
      No prefix in generated macro

config BT_IND_RESET
    bool "BT_IND_RESET"
    help
      This symbol is a config macro.

config BT_IND_RESET_OOB
    bool "BT_IND_RESET_OOB"
    help
      This symbol is a config macro.

config BUTTON_COUNT
    int "BUTTON_COUNT"
    default 0
    help
      This symbol is a config macro.
      No prefix in generated macro

endmenu
```

## include/bluetooth/audio/config/Kconfig
```kconfig
# Copyright 2024 NXP
menu "Edgefast Bluetooth Audio Configurations(edgefast_bluetooth_audio_config.h)"

config BT_AUDIO
    bool "BT_AUDIO"
    default n
    help
      Enable BT AUDIO 
      This symbol is a config macro.

if BT_AUDIO

config BT_AUDIO_RX
    bool "BT_AUDIO_RX"
    default n
    help
      This hidden option is enabled when any of the profiles/services
      enables support for receiving of audio data.
      This symbol is a config macro.

config BT_AUDIO_TX
    bool "BT_AUDIO_TX"
    default n
    help
      This hidden option is enabled when any of the profiles/services
      enables support for transmitting of audio data.
      This symbol is a config macro.
     

config BT_AUDIO_NOTIFY_RETRY_DELAY
    int "BT_AUDIO_NOTIFY_RETRY_DELAY"
    default 20
    help
      This option sets the time in 1.25 ms units before the stack will
      retry to send notification that failed due to lack of TX buffers
      available.
      Delay for notification sending retried attempt in 1.25 ms units
      range 6 ~ 3200
      This symbol is a config macro.
     

config BT_CCID
    bool "BT_CCID"
    default n
    help
      This hidden option is enabled when any of the content control
      features are enabled.
      This symbol is a config macro.

rsource "Kconfig.bap"
rsource "Kconfig.vocs"
rsource "Kconfig.aics"
rsource "Kconfig.vcp"
rsource "Kconfig.micp"
rsource "Kconfig.csip"
rsource "Kconfig.tbs"
rsource "Kconfig.mcs"
rsource "Kconfig.has"
rsource "Kconfig.mpl"
rsource "Kconfig.mctl"
rsource "Kconfig.cap"
rsource "Kconfig.tmap"
rsource "Kconfig.gmap"
rsource "Kconfig.pbp"
rsource "Kconfig.extension"

endif # BT_AUDIO

rsource "../../services/config/Kconfig"

endmenu
```
